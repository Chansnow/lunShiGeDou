#include "STM32Lib\\stm32f10x.h"
#include "UP_Variable.h"
u32 UP_System_Time;
u16 UP_System_Vcc;
u8 UP_System_RecCmd_Start = 0;
u8 UP_System_RouteIndex = 0;

u8 UP_Car_Wait_ToStart = 0;
u8 UP_Car_Wait_Start = 0;

u8 UP_Car_ChargeWait_ToStart = 0;


u8 UP_Car_WaitCharge = 0;


u8 UP_Route_NodeNum=10;
u8 UP_Route_Info[50][4];
u8 UP_Route_InfoIndex = 0;
u8 UP_Route_StopCount = 0;

u8 UP_Back_CrossAllowSign = 1;

u16 UP_Illegal_CheckData[4];


u8 UP_RFID_CrossID[36][5] = {0x01,0xea,0xc9,0x93,0xb1,//0-12
							0x01,0xe7,0x87,0x23,0x42,//1-13
							0x01,0xea,0x54,0x83,0x3c,//2-14
							0x01,0xeb,0x11,0x63,0x98,//3-22
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							0xfb,0xa9,0x4e,0x42,0x5e};//35-113
u8 UP_RFID_GetIdIndex(u8 node)//将节点号转换为卡号在数组中的位置
{
	u8 temp;
	switch(node)
	{
		case 12:temp=0;break;
		case 13:temp=1;break;
		case 14:temp=2;break;
		case 22:temp=3;break;
		case 23:temp=4;break;
		case 24:temp=5;break;
		case 31:temp=6;break;
		case 32:temp=7;break;
		case 34:temp=8;break;
		case 42:temp=9;break;
		case 43:temp=10;break;
		case 44:temp=11;break;
		case 51:temp=12;break;
		case 52:temp=13;break;
		case 54:temp=14;break;
		case 61:temp=15;break;
		case 63:temp=16;break;
		case 64:temp=17;break;
		case 71:temp=18;break;
		case 72:temp=19;break;
		case 73:temp=20;break;
		case 81:temp=21;break;
		case 84:temp=22;break;
		case 101:temp=23;break;
		case 102:temp=24;break;
		case 103:temp=25;break;
		case 104:temp=26;break;
		case 105:temp=27;break;
		case 106:temp=28;break;
		case 107:temp=29;break;
		case 108:temp=30;break;
		case 109:temp=31;break;
		case 110:temp=32;break;
		case 111:temp=33;break;
		case 112:temp=34;break;
		case 113:temp=35;break;
		default:temp=0xff;break;
	}
	return temp;
}

void UP_Clear_RoutInfo(void)
{
	u8 i,j;
	for(i=0;i<50;i++)
		for(j=0;j<4;j++)
			UP_Route_Info[i][j] = 0x00;
}















